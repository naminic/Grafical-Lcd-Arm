//-----------------------
// #ifndef glcd_INCLUDED_
// #define glcd_INCLUDED_
#include "glcd.h"
#include "font.h"
#include <board.h>
#include <pio/pio.h>
#include <ssc/ssc.h>
#include <stdlib.h>
#include <string.h>
#include <stdio.h>
//-----------------------
#define KS0108_SCREEN_WIDTH	128
#define KS0108_SCREEN_HEIGHT 64


#define DISPLAY_SET_Y       0x40
#define DISPLAY_SET_X       0xB8
#define DISPLAY_START_LINE  0xC0
#define DISPLAY_ON_CMD		0x3E
#define ON	0x01
#define OFF	0x00
#define DISPLAY_STATUS_BUSY	0x80

#define DATAREG 1    
#define CONTROL 0    
#define LCD_ENABLE      1   //Zero Bit
#define LCD_CS1      0
#define LCD_CS2      1

#define DELAY()           { int i=200; while(i-- != 0); }

void glcd_init(void);
void GLCD_DisableController(unsigned char controller);
void GLCD_EnableController(unsigned char controller);
void GLCD_WriteCommand(unsigned char commandToWrite, unsigned char controller);
static void DATAPORT(char val);
void GLCD_WriteData(unsigned char dataToWrite);
unsigned char GLCD_ReadByteFromROMMemory(char * ptr);
void GLCD_ClearScreen(void);
void GLCD_GoTo(unsigned char x, unsigned char y);
void GLCD_WriteChar(char charToWrite);
void GLCD_WriteString(char * stringToWrite);
void GLCD_Bitmap(char * bmp, unsigned char x, unsigned char y, unsigned char dx, unsigned char dy);
void putpixel(unsigned int x, unsigned int y);
void SetPage(unsigned char x);
void SetColumn(unsigned char y);
unsigned char pow2(unsigned char a,unsigned char b);
void sendlcddataram(unsigned char values);
void output(int port, unsigned char value);
int  GLCD_Write_farsi(char charToWrite);
void GLCD_WriteString_farsi(unsigned char * stringToWrite,int i);

	   const unsigned char F_FONT_MAP[111][4]={
  0xFF, 0xFF, 0xFF, 0xFF,  // 127  =>
  0xFF, 0xFF, 0xFF, 0xFF,  // 128  =>
  0x06, 0x06, 0x05, 0x05,  // 129  =>   ?
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  0x3F, 0x3E, 0x3D, 0x3D  // 237  =>   ?
};

    	const static char farsi[78][8] = {
       0x00, 0x00, 0x00, 0x00, 0x04, 0x02, 0x3A, 0x02,
       0x00, 0x00, 0x00, 0x00, 0x00, 0x00, 0x00, 0x1E,
       0x00, 0x00, 0x00, 0x00, 0x00, 0x00, 0x00, 0x3E,
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       0x00, 0x00, 0x00, 0x00, 0x0C, 0x12, 0x12, 0x7C,
       };
			 
			 
static const char font5x8[] = {
0x00, 0x00, 0x00, 0x00, 0x00,// (spacja)
0x00, 0x00, 0x5F, 0x00, 0x00,// !
0x00, 0x07, 0x00, 0x07, 0x00,// "
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0x08, 0x1C, 0x2A, 0x08, 0x08 // <-
};
static const Pin GLcdpins[] = {GLCD_PINS};
static const Pin sscPins[] = {PIN_SSC_TD, PIN_SSC_TK,PIN_SSC_TF};
//-------------------------
unsigned char screen_x = 0, screen_y = 0;
unsigned char CurrentColumn,DisplayData[8][128];
//----------------------
static void DATAPORT(char val)
{
	SSC_Write(AT91C_BASE_SSC,0);
	SSC_Write(AT91C_BASE_SSC,val);
}

//------------------------
//-------------------------------------------------------------------------------------------------
//
//-------------------------------------------------------------------------------------------------
void GLCD_DisableController(unsigned char controller)
{
switch(controller){
	case 0 : PIO_Set(&GLcdpins[4]); break;
	case 1 : PIO_Set(&GLcdpins[3]); break;
	}
}

//-------------------------------------------------------------------------------------------------
//
//-------------------------------------------------------------------------------------------------
void GLCD_EnableController(unsigned char controller)
{
    switch(controller)
    {
        case 0 : PIO_Clear(&GLcdpins[4]); break;
        case 1 : PIO_Clear(&GLcdpins[3]); break;
    }
}
//-------------------------------------------------------------------------------------------------
//
//-------------------------------------------------------------------------------------------------
void GLCD_WriteCommand(unsigned char commandToWrite, unsigned char controller)
{
unsigned int command;
DELAY();

PIO_Clear(&GLcdpins[0]);
PIO_Clear(&GLcdpins[2]);
GLCD_EnableController(controller);
command=commandToWrite;
DATAPORT(command);	
PIO_Set(&GLcdpins[1]);	
DELAY();	
PIO_Clear(&GLcdpins[1]);	
GLCD_DisableController(controller);
}
//-------------------------------------
void GLCD_WriteData(unsigned char dataToWrite)
{
unsigned int byte;
DELAY() 	
PIO_Clear(&GLcdpins[2]);
PIO_Set(&GLcdpins[0]);	
byte = dataToWrite;
DATAPORT(byte);	
GLCD_EnableController(screen_x / 64);
PIO_Set(&GLcdpins[1]);
DELAY();	
PIO_Clear(&GLcdpins[1]);	
GLCD_DisableController(screen_x / 64);
screen_x++;
}

//-----------------------------
void GLCD_GoTo(unsigned char x, unsigned char y)
{
unsigned char i;
screen_x = x;
screen_y = y;

for(i = 0; i < KS0108_SCREEN_WIDTH/64; i++)
{
    GLCD_WriteCommand(DISPLAY_SET_Y | 0,i);
    GLCD_WriteCommand(DISPLAY_SET_X | y,i);
    GLCD_WriteCommand(DISPLAY_START_LINE | 0,i);
}
GLCD_WriteCommand(DISPLAY_SET_Y | (x % 64), (x / 64));
GLCD_WriteCommand(DISPLAY_SET_X | y, (x / 64));
}

//---------------------------
unsigned char GLCD_ReadByteFromROMMemory(char * ptr)
{
return *(ptr);
}

//---------------------------
void glcd_init(void)
{
	unsigned int tcmr,tfmr;
	unsigned char i;
  
  PIO_Configure(GLcdpins,PIO_LISTSIZE(GLcdpins));
	PIO_Configure(sscPins, PIO_LISTSIZE(sscPins));	
	
	PIO_Set(&GLcdpins[3]);
	PIO_Set(&GLcdpins[4]);
	
	SSC_Configure(AT91C_BASE_SSC,AT91C_ID_SSC,500000,BOARD_MCK);
    
  tcmr=AT91C_SSC_CKS_TK|AT91C_SSC_CKO_DATA_TX|AT91C_SSC_START_CONTINOUS;
  tfmr=SSC_DATLEN(8)|SSC_DATNB(15)|SSC_FSLEN(16)|AT91C_SSC_FSOS_LOW|AT91C_SSC_FSDEN ;
    
  SSC_ConfigureTransmitter(AT91C_BASE_SSC,tcmr,tfmr);
  SSC_EnableTransmitter(AT91C_BASE_SSC);
	
	PIO_Set(&GLcdpins[5]); 
  //PIO_Clear(&GLcdpins[5]);
	for(i = 0; i < 3; i++);
  GLCD_WriteCommand((DISPLAY_ON_CMD | ON), i);
	
}	
//--------------------------------
void GLCD_ClearScreen(void)
{
unsigned char i, j;
for(j = 0; j < KS0108_SCREEN_HEIGHT/8; j++)
  {
    GLCD_GoTo(0,j);
    for(i = 0; i < KS0108_SCREEN_WIDTH; i++)
        GLCD_WriteData(0x00);
  }
}

//-------------------------------------------------------------------------------------------------
//
//-------------------------------------------------------------------------------------------------
void GLCD_WriteChar(char charToWrite)
{
int i;
charToWrite -= 32; 
for(i = 0; i < 5; i++) 
  GLCD_WriteData(GLCD_ReadByteFromROMMemory((char *)((int)font5x8 + (5 * charToWrite) + i))); 
GLCD_WriteData(0x00);
}
//-------------------------------------------------------------------------------------------------
//
//-------------------------------------------------------------------------------------------------
void GLCD_WriteString(char * stringToWrite)
{
while(*stringToWrite)
  GLCD_WriteChar(*stringToWrite++);
}

//-----------------------
void SetPage(unsigned char x){
	GLCD_WriteCommand(DISPLAY_SET_X | x, 0);
	GLCD_WriteCommand(DISPLAY_SET_X | x, 1);
}
//-----------------------
void SetColumn(unsigned char y){
CurrentColumn = y;
if (y < 64){
	GLCD_WriteCommand(DISPLAY_SET_Y | (y&63), 0);
	GLCD_WriteCommand(DISPLAY_SET_Y | 0, 1);
	 }
else{
	GLCD_WriteCommand(DISPLAY_SET_Y | 63, 0);
	GLCD_WriteCommand(DISPLAY_SET_Y | ((y-64)&63), 1);
	 }
}
//-----------------------
unsigned char pow2(unsigned char a,unsigned char b){
unsigned char i=0,ret=1;
for(;i<b;i++) ret*=a;
return ret;
}
//-----------------------
void sendlcddataram(unsigned char values){
unsigned char c_s;
c_s = CurrentColumn>63?LCD_CS2:LCD_CS1;
output(CONTROL, c_s );   
DELAY();
output(DATAREG,values); 
DELAY();
output(CONTROL, LCD_ENABLE | c_s ); 
DELAY();
}
//-----------------------
void output(int port, unsigned char value){

int dummy=0;  
if(port){
    dummy = ((unsigned int)value & 0xFC) <<24 | ((unsigned int)value & 0x01)<<17  | ((unsigned int)value & 0x02)<<17;
    //AT91F_PIO_ClearOutput ( AT91C_BASE_PIOA, 1<<17 | 1<<18 | 1<<26 | 1<<27 | 1<<28 | 1<<29 | 1<<30 | 1<<31 );
    //AT91F_PIO_SetOutput ( AT91C_BASE_PIOA, dummy);  
DATAPORT(dummy);  
}
else{
	if(value&1) value&=0XFE; else value|=1;
	if(value&2) value&=0XFD; else value|=2;
	if(value&8) value&=0XF7; else value|=8;

	//CTRLPORT=value;     
	}
}
//-----------------------

//-----------------------
void putpixel(unsigned int x, unsigned int y)
{
    unsigned char tmp=0;
    GLCD_GoTo(x, (y / 8));
    tmp |= (1 << (y % 8));
    GLCD_WriteData(tmp);
}
void GLCD_Bitmap(char * bmp, unsigned char x, unsigned char y, unsigned char dx, unsigned char dy)
{
unsigned char i, j;
for(j = 0; j < dy / 8; j++)
  {
  GLCD_GoTo(x,y + j);
  for(i = 0; i < dx; i++) 
    GLCD_WriteData(GLCD_ReadByteFromROMMemory(bmp++));
  }
}
//-----------------------

//-----------------------
void GLCD_Write_font(char charToWrite)
{
	int i;
	for(i = 0; i < 8; i++) 
		GLCD_WriteData(GLCD_ReadByteFromROMMemory((char *)((int)font + (8 * charToWrite) + i))); 
}
//-----------------------

//-----------------------
int  GLCD_Write_farsi(char charToWrite)
{
//charToWrite -= 32; 
 char  bit_8;
int i,ii=0;
for(i = 0; i < 8; i++)
{
    bit_8=GLCD_ReadByteFromROMMemory((char *)((int)farsi + (8 * charToWrite) + i));
	if(bit_8 == 0x00)
	         ii++;
  GLCD_WriteData(bit_8); 
}
   return (ii);
}

//-----------------------

//-----------------------

void GLCD_WriteString_farsi(unsigned char * stringToWrite,int i)
{
    unsigned char buffer[18],char_to_write;
	unsigned  char *str,val;
	str=buffer+1;
	int  index=0,data;
	int  j=1,k=1,d=0;
while(*stringToWrite)
   {
       buffer[j]=*stringToWrite;
	   stringToWrite++;
	   j++;
   }
	  buffer[0]=32;
	  buffer[j+1]='\0';
	  buffer[j+2]='\0';

	while(*str)
	{
	   
      str--;
      val = *str;
      str++;
      if(val==32 || val==199 || val==194 || val==207 || val==208 || val==209 || val==210 || val==142 || val==230)
      {
          str++;
          val = *str;
          str--;
          if(val==32 || val=='\0')
          data = 0;
          else
          data = 3;
      }
      else
      {
           str++;
           val = *str;
           str--;
           if(val==32 || val=='\0')
           data = 1;
           else
           data = 2;
       }
	   if(*str>=127)
	   {    
		   char_to_write=F_FONT_MAP[*str-127][data];
		    
	        GLCD_GoTo((128-k*8+index),i); 
			k++;
			str++;
		   index=GLCD_Write_farsi(char_to_write)+index;
		}
		else
		{
		  	 char_to_write=*str;
	 
	 	     GLCD_GoTo((d*8),i);
			  d++;
			  str++;
			 GLCD_Write_font(char_to_write);
		}
	 }
}

